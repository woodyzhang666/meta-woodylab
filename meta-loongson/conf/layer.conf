## meta-loongson/conf/layer.conf
```bitbake
# We have a conf and classes directory, append to BBPATH
BBPATH .= ":${LAYERDIR}"

# We have a recipes directory, add to BBFILES
BBFILES += "${LAYERDIR}/recipes*/*/*.bb ${LAYERDIR}/recipes*/*/*.bbappend"

BBFILE_COLLECTIONS += "meta-loongson"
BBFILE_PATTERN_meta-loongson := "^${LAYERDIR}/"
BBFILE_PRIORITY_meta-loongson = "10"

# This should only be incremented on significant changes that will
# cause compatibility issues with other layers
LAYERVERSION_meta-loongson = "1"

LAYERDEPENDS_meta-loongson = "core"

LAYERSERIES_COMPAT_meta-loongson = "honister kirkstone langdale"
```

## meta-loongson/conf/machine/include/loongarch/tune-loongarch.inc
```bitbake
require conf/machine/include/loongarch/arch-loongarch.inc

TUNEVALID[loongarch64] = "Enable 64-bit LoongArch optimizations"
TUNEVALID[loongarch32] = "Enable 32-bit LoongArch optimizations"

AVAILTUNES += "loongarch64 loongarch32"

# Default
TUNE_FEATURES:tune-loongarch64= "loongarch64"
TUNE_ARCH:tune-loongarch64= "loongarch64"
TUNE_PKGARCH:tune-loongarch64= "loongarch64"
PACKAGE_EXTRA_ARCHS:tune-loongarch64= "loongarch64"

TUNE_FEATURES:tune-loongarch32 = "loongarch32"
TUNE_ARCH:tune-loongarch32 = "loongarch32"
TUNE_PKGARCH:tune-loongarch32 = "loongarch32"
PACKAGE_EXTRA_ARCHS:tune-loongarch32 = "loongarch32"
```

## meta-loongson/wic/timcreate-l5a2.wks
```
# short-description: Create an EFI disk image
# long-description: Creates a partitioned EFI disk image that the user
# can directly dd to boot media.

part /boot --source bootimg-efi --sourceparams="loader=grub-efi" --ondisk sda --label msdos --active --align 1024

part / --source rootfs --ondisk sda --fstype=ext4 --label platform --align 1024 --use-uuid

part swap --ondisk sda --size 44 --label swap1 --fstype=swap

bootloader --ptable gpt --timeout=5 --append="rootfstype=ext4 earlycon=uart,mmio,0x1fe001e0,115200n8 console=ttyS0,115200 console=tty0"
```

## meta-woody/conf/distro/woody-altcfg.conf
```bitbake
#
# An example of subclassing a distro, primarily used for testing alternate configuration
# combinations on the Yocto Project autobuilder
#
require conf/distro/woody.conf

DISTRO = "woody-altcfg"
DISTROOVERRIDES = "woody:woody-altcfg"
#DISTROOVERRIDES = "poky:linuxstdbase"
DISTRO_FEATURES:remove = "systemd"

INIT_MANAGER:woody-altcfg = "sysvinit"

require conf/distro/include/woody-distro-alt-test-config.inc
```

## meta-woody/conf/distro/woody.conf
```bitbake
DISTRO = "woody"
DISTRO_NAME = "Woody (Woodylab Distro)"
#DISTRO_VERSION = "4.1+snapshot-${METADATA_REVISION}"
DISTRO_VERSION = "4.1"
DISTRO_CODENAME = "langdale"
SDK_VENDOR = "-woodysdk"
SDK_VERSION = "${@d.getVar('DISTRO_VERSION').replace('snapshot-${METADATA_REVISION}', 'snapshot')}"
SDK_VERSION[vardepvalue] = "${SDK_VERSION}"

MAINTAINER = "Woody <woodylab@foxmail.com>"

TARGET_VENDOR = "-woody"

LOCALCONF_VERSION = "2"

# Override these in poky based distros
WOODY_DEFAULT_DISTRO_FEATURES = "largefile opengl ptest multiarch wayland \
            vulkan wifi nfs usrmerge"

WOODY_DEFAULT_EXTRA_RDEPENDS = "packagegroup-core-boot"
WOODY_DEFAULT_EXTRA_RRECOMMENDS = "kernel-module-af-packet"

DISTRO_FEATURES ?= "${DISTRO_FEATURES_DEFAULT} ${WOODY_DEFAULT_DISTRO_FEATURES}"

IMAGE_FSTYPES += "cpio.gz tar.bz2 ext4 wic"

# If set to boolean false ('no', 'n', 'false', 'f', '0'), /var/log is on persistent storage.
VOLATILE_LOG_DIR = "no"

PREFERRED_VERSION_linux-yocto ?= "5.19%"
PREFERRED_VERSION_linux-yocto-rt ?= "5.19%"

SDK_NAME = "${DISTRO}-${TCLIBC}-${SDKMACHINE}-${IMAGE_BASENAME}-${TUNE_PKGARCH}-${MACHINE}"
SDKPATHINSTALL = "/opt/${DISTRO}/${SDK_VERSION}"

#SDK_RDEPENDS += "zlib libmd"

DISTRO_EXTRA_RDEPENDS += "${WOODY_DEFAULT_EXTRA_RDEPENDS}"
DISTRO_EXTRA_RRECOMMENDS += "${WOODY_DEFAULT_EXTRA_RRECOMMENDS}"

# replace busybox
VIRTUAL-RUNTIME_base-utils ?= "packagegroup-core-base-utils"
VIRTUAL-RUNTIME_base-utils-hwclock ?= "util-linux-hwclock"
VIRTUAL-RUNTIME_base-utils-syslog ?= "syslog-ng"
VIRTUAL-RUNTIME_vim ?= "vim"

TCLIBCAPPEND = ""

PACKAGE_CLASSES = "package_deb"

SANITY_TESTED_DISTROS ?= " \
            poky-4.0 \n \
            poky-4.1 \n \
            ubuntu-18.04 \n \
            ubuntu-20.04 \n \
            ubuntu-21.10 \n \
            ubuntu-22.04 \n \
            fedora-34 \n \
            fedora-35 \n \
            debian-10 \n \
            debian-11 \n \
            opensuseleap-15.3 \n \
            almalinux-8.5 \n \
            "
# add poky sanity bbclass
#INHERIT += "woody-sanity"

# QA check settings - a little stricter than the OE-Core defaults
# (none currently necessary as we now match OE-Core)
#WARN_TO_ERROR_QA = "X"
#WARN_QA_remove = "${WARN_TO_ERROR_QA}"
#ERROR_QA_append = " ${WARN_TO_ERROR_QA}"

require conf/distro/include/woody-world-exclude.inc
require conf/distro/include/no-static-libs.inc
require conf/distro/include/yocto-uninative.inc
require conf/distro/include/security_flags.inc
INHERIT += "uninative"

BB_SIGNATURE_HANDLER ?= "OEEquivHash"
BB_HASHSERVE ??= "auto"

INIT_MANAGER = "systemd"

# We need debug symbols so that SPDX license manifests for the kernel work
KERNEL_EXTRA_FEATURES:append = " features/debug/debug-kernel.scc"
```

## meta-woody/conf/layer.conf
```bitbake
# We have a conf and classes directory, add to BBPATH
BBPATH =. "${LAYERDIR}:"

# We have recipes-* directories, add to BBFILES
BBFILES += "${LAYERDIR}/recipes-*/*/*.bb \
            ${LAYERDIR}/recipes-*/*/*.bbappend"

BBFILE_COLLECTIONS += "woody"
BBFILE_PATTERN_woody = "^${LAYERDIR}/"
BBFILE_PRIORITY_woody = "5"

LAYERSERIES_COMPAT_woody = "kirkstone langdale mickledore"

# This should only be incremented on significant changes that will
# cause compatibility issues with other layers
LAYERVERSION_woody = "3"

LAYERDEPENDS_woody = "core meta-python"

REQUIRED_POKY_BBLAYERS_CONF_VERSION = "2"
```

## meta-woody/conf/machine/include/loongarch/arch-loongarch.inc
```bitbake
# LoongArch Architecture definition

DEFAULTTUNE ?= "loongarch64"

TUNE_ARCH = "${TUNE_ARCH:tune-${DEFAULTTUNE}}"
TUNE_PKGARCH = "${TUNE_PKGARCH:tune-${DEFAULTTUNE}}"
TUNE_CCARGS:append = "${@bb.utils.contains('TUNE_FEATURES', 'loongarch64', ' -mabi=lp64d', ' ', d)}"
TUNE_CCARGS:append = "${@bb.utils.contains('TUNE_FEATURES', 'loongarch32', ' -mabi=ilp32', ' ', d)}"

# Fix: ld: unrecognized option '--hash-style=sysv'
#LINKER_HASH_STYLE:libc-newlib = ""
# Fix: ld: unrecognized option '--hash-style=gnu'
#LINKER_HASH_STYLE:libc-baremetal = ""
```

## meta-woody/conf/machine/licheerv_dock.conf
```bitbake
#@TYPE: Machine
#@NAME: licheerv_dock
#@SOC: Allwinner D1
#@DESCRIPTION: Machine configuration for Sipeed LicheeRV Dock board

require conf/machine/include/riscv/tune-riscv.inc

MACHINE_FEATURES = "screen keyboard ext2 ext3 serial usbhost usbgadget \
    wifi alsa bluetooth"

KERNEL_IMAGETYPE = "Image"
PREFERRED_PROVIDER_virtual/kernel = "linux-woody-dev"
PREFERRED_PROVIDER_virtual/bootloader = "u-boot-d1"

EXTRA_IMAGEDEPENDS += "opensbi u-boot-d1"
RISCV_SBI_PLAT = "generic"
MACHINE_ESSENTIAL_EXTRA_RDEPENDS += "kernel-image u-boot-d1 kernel-devicetree"

UBOOT_EXTLINUX = "1"
UBOOT_EXTLINUX_CONSOLE = "console=ttyS0,115200n8"
UBOOT_EXTLINUX_KERNEL_ARGS = "rootwait rw"
UBOOT_EXTLINUX_ROOT = "root=/dev/mmcblk0p1"
UBOOT_MACHINE = "lichee_rv_dock_defconfig"
UBOOT_BINARY = "u-boot-sunxi-with-spl.bin"
#UBOOT_EXTLINUX_FDT = "../sun20i-d1-lichee-rv-dock.dtb"
UBOOT_EXTLINUX_FDTDIR = ""

SERIAL_CONSOLES = "115200;ttyS0"

MACHINE_EXTRA_RRECOMMENDS += " kernel-modules"

IMAGE_FSTYPES += "wic.gz wic.bmap"

### 'KERNEL_DEVICETREE' isn't used because the DTB is loaded from RAM
### at address ${fdtcontroladdr}
KERNEL_DEVICETREE ?= "allwinner/sun20i-d1-lichee-rv-dock.dtb"
KERNEL_FEATURES:append = " cfg/sound.scc"
KERNEL_FEATURES:append = " features/media/media.scc"
KERNEL_FEATURES:append = " features/media/media-usb-webcams.scc"

IMAGE_INSTALL:append = " rtl8723ds-mod"

## Do not update fstab file when using wic images
WIC_CREATE_EXTRA_ARGS ?= "--no-fstab-update"

## wic default support
WKS_FILE_DEPENDS ?= " \
    u-boot-d1 \
    opensbi \
    e2fsprogs-native \
    bmap-tools-native \
"

IMAGE_BOOT_FILES ?= " \
    ${KERNEL_IMAGETYPE} \
"

WKS_FILE ?= "nezha.wks"

KVMD_PLATFORM = "woodylab-hdmiusb"
KVMD_BOARD = "d1"

PACKAGECONFIG:pn-libgpiod += "tests python3"
```

## meta-woody/conf/machine/timcreate-l5a2.conf
```bitbake
#@TYPE: Machine
#@NAME: TIMCREATE L5A2 machine
#@DESCRIPTION: Machine configuration for running 3A5000-7A2000 TIMCREATE board

require conf/machine/include/loongarch/tune-loongarch.inc

MACHINE_FEATURES = "screen keyboard ext2 ext3 serial acpi alsa vfat pci \
                    usbhost"

MACHINE_FEATURES_BACKFILL_CONSIDERED:append = "qemu-usermode"

KERNEL_IMAGETYPE = "vmlinux.efi"
KERNEL_IMAGETYPES += "vmlinux.efi"

SERIAL_CONSOLES ?= "115200;ttyS0"
SERIAL_CONSOLES_CHECK = "${SERIAL_CONSOLES}"

IMAGE_FSTYPES += "wic.gz wic.bmap"
WKS_FILE = "timcreate-l5a2.wks"

GRUB_BUILDIN = "all"

MACHINE_EXTRA_RRECOMMENDS += " kernel-modules"

PREFERRED_PROVIDER_virtual/kernel = "linux-woody-dev"
#PREFERRED_VERSION_linux-woody-dev = "6.1%"

IMAGE_INSTALL += "acpica apt"
```

## meta-woody/wic/nezha.wks
```
# short-description: Create SD card image for Nezha Allwinner D1 development board

part boot0 --source rawcopy --sourceparams="file=u-boot-sunxi-with-spl.bin" --offset 16s --ondisk mmcblk0 --no-table

part /     --source rootfs --ondisk mmcblk0 --fstype=ext4 --label rootfs  --align 4096 --fixed-size 14000 --exclude-path data/
```
